## config/boards/shields/mykeyboard/Kconfig.defconfig
```kconfig
if SHIELD_MYKEYBOARD_LEFT

config ZMK_KEYBOARD_NAME
    default "Mykeyboard"

config ZMK_SPLIT_ROLE_CENTRAL
    default y

endif

if SHIELD_MYKEYBOARD_LEFT || SHIELD_MYKEYBOARD_RIGHT

config ZMK_SPLIT
    default y

endif
```

## config/boards/shields/mykeyboard/Kconfig.shield
```kconfig
config SHIELD_MYKEYBOARD_LEFT
    def_bool $(shields_list_contains,mykeyboard_left)

config SHIELD_MYKEYBOARD_RIGHT
    def_bool $(shields_list_contains,mykeyboard_right)
```
